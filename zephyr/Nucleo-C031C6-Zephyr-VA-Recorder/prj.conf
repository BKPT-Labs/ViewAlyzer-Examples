## CMakeLists.txt
```
# ViewAlyzer on the ST NUCLEO-C031C6 (Cortex-M0+, 12 KB RAM / 32 KB flash).
# The recorder is pulled in as a Zephyr extra module from this repo's
# shared ViewAlyzerRecorder tree - no sources are copied.
cmake_minimum_required(VERSION 3.20.0)

# ── Locate the ViewAlyzer Recorder (Zephyr module) ────────────────────
# Resolution order:
#   1. -DVIEWALYZER_MODULE_PATH=<path> on the west/cmake command line
#   2. The VIEWALYZER_MODULE_PATH environment variable
#   3. A ViewAlyzer checkout cloned next to this examples repo:
#      <workspace>/ViewAlyzer/ViewAlyzerRecorder
if(NOT DEFINED VIEWALYZER_MODULE_PATH)
  if(DEFINED ENV{VIEWALYZER_MODULE_PATH})
    set(VIEWALYZER_MODULE_PATH "$ENV{VIEWALYZER_MODULE_PATH}")
  else()
    set(VIEWALYZER_MODULE_PATH
        "${CMAKE_CURRENT_SOURCE_DIR}/../../../ViewAlyzer/ViewAlyzerRecorder")
  endif()
endif()
get_filename_component(VIEWALYZER_MODULE_PATH "${VIEWALYZER_MODULE_PATH}" ABSOLUTE)
if(NOT EXISTS "${VIEWALYZER_MODULE_PATH}/zephyr/module.yml")
  message(FATAL_ERROR
    "ViewAlyzer Recorder not found at: ${VIEWALYZER_MODULE_PATH}\n"
    "Clone the ViewAlyzer repo next to this examples repo, or point "
    "VIEWALYZER_MODULE_PATH (CMake option or environment variable) at a "
    "ViewAlyzerRecorder directory.")
endif()
list(APPEND ZEPHYR_EXTRA_MODULES ${VIEWALYZER_MODULE_PATH})
find_package(Zephyr REQUIRED HINTS $ENV{ZEPHYR_BASE})
project(nucleo-c031c6-va-recorder)

target_sources(app PRIVATE src/main.c)
```

## prj.conf
```kconfig
# ViewAlyzer on the NUCLEO-C031C6 (STM32C031C6, Cortex-M0+).
#
# Two constraints shape this example:
#   - ARMv6-M: no DWT cycle counter, no ITM. Timestamps come from a user
#     timer (TIM3, src/main.c) and the transport is the RAM buffer drained
#     by the on-board ST-LINK.
#   - The C031 has NO 32-bit timer at all, so this is the reference user
#     of the 16-BIT timer source (CONFIG_VIEWALYZER_TIMER_BITS=16). The
#     tick is prescaled to 100 kHz so the counter wraps every 655 ms and
#     the main loop's VA_TickOverflowCheck() cadence covers the wrap
#     budget comfortably (see the timer comment in src/main.c).
#
# 12 KB RAM / 32 KB flash also make it the smallest recorder target so
# far, hence the trimmed ring, registries, and stacks below.

# ── ViewAlyzer recorder + user-trace hook (both required) ─────────────
CONFIG_VIEWALYZER=y
CONFIG_TRACING_USER=y

# ── Transport: RAM buffer over the on-board ST-LINK ───────────────────
CONFIG_VIEWALYZER_TRANSPORT_RAMBUF=y
CONFIG_VIEWALYZER_RAMBUF_SIZE=2048

# ── Timestamp source: custom free-running timer (TIM3, 16-bit) ────────
CONFIG_VIEWALYZER_TS_CUSTOM_TIMER=y
CONFIG_VIEWALYZER_TIMER_BITS=16

# ── Recorder sizes, trimmed for 12 KB of RAM ──────────────────────────
CONFIG_VIEWALYZER_MAX_TASKS=8
CONFIG_VIEWALYZER_MAX_SYNC_OBJECTS=8
CONFIG_VIEWALYZER_MAX_USER_EVENTS=4
CONFIG_VIEWALYZER_MAX_GPIOS=4
CONFIG_VIEWALYZER_MAX_HEAP_GAUGES=2

# ── Kernel features the recorder relies on ────────────────────────────
CONFIG_MULTITHREADING=y
CONFIG_THREAD_NAME=y
CONFIG_THREAD_MONITOR=y
CONFIG_THREAD_STACK_INFO=y

# ── Footprint ─────────────────────────────────────────────────────────
CONFIG_MAIN_STACK_SIZE=1280
CONFIG_IDLE_STACK_SIZE=320
CONFIG_SYSTEM_WORKQUEUE_STACK_SIZE=512

# ── Demo application ──────────────────────────────────────────────────
CONFIG_GPIO=y
```

## src/main.c
```c
/*
 * ViewAlyzer on the ST NUCLEO-C031C6 (STM32C031C6, Cortex-M0+).
 *
 * The 16-BIT timer-source reference: the C031 has no DWT, no ITM, and no
 * 32-bit timer, so timestamps come from 16-bit TIM3 through the recorder's
 * CUSTOM_TIMER source with VA_TIMER_BITS=16, and the transport is the RAM
 * buffer drained by the on-board ST-LINK.
 *
 * Kept deliberately small (12 KB RAM / 32 KB flash): a heartbeat in main
 * plus one worker thread contending on a mutex, publishing two integer
 * counters - enough for the timeline to show scheduling, and nothing that
 * needs a float libc.
 */

#include <stdint.h>
#include <zephyr/kernel.h>
#include <zephyr/drivers/gpio.h>
#include <soc.h>                     /* TIM3 / RCC register definitions */

#include "ViewAlyzer.h"
#include "VA_Adapter_Zephyr.h"

#define LED0_NODE DT_ALIAS(led0)
static const struct gpio_dt_spec led = GPIO_DT_SPEC_GET(LED0_NODE, gpios);

/* ---------------- Timestamp source: TIM3 as a 100 kHz free-runner -------
 * TIM3 is 16-bit, so the wrap budget rules from ViewAlyzerConfig.h apply:
 * at 100 kHz the counter wraps every 655 ms, and the recorder must see at
 * least one clock read per wrap. Every emitted event reads the clock, and
 * the main loop below calls VA_TickOverflowCheck() every 50 ms as the
 * quiet-gap backstop - a >13x margin. Timestamp resolution is 10 us.
 *
 * The timer kernel clock equals the CPU clock (48 MHz) because this board
 * config runs AHB and APB undivided (Zephyr's nucleo_c031c6 devicetree);
 * with an APB prescaler other than /1, STM32 timers clock at 2x APB and
 * this prescaler computation would need that factor. Nothing else in this
 * project claims TIM3 (no PWM/counter driver is enabled).
 */
#define TICK_HZ           100000u
#define TIM3_CLOCK_HZ     ((uint32_t)CONFIG_SYS_CLOCK_HW_CYCLES_PER_SEC)

static void tick_timer_init(void)
{
    RCC->APBENR1 |= RCC_APBENR1_TIM3EN;
    (void)RCC->APBENR1;              /* read back: peripheral-enable delay */

    TIM3->PSC = (uint16_t)((TIM3_CLOCK_HZ / TICK_HZ) - 1u);
    TIM3->ARR = 0xFFFFu;             /* full 16-bit span */
    TIM3->EGR = TIM_EGR_UG;          /* latch PSC/ARR now, not at wrap */
    TIM3->CR1 = TIM_CR1_CEN;
}

static uint32_t tick_timer_read(void)
{
    return TIM3->CNT;                /* low 16 bits used (VA_TIMER_BITS=16) */
}

/* ---------------- User-trace IDs ---------------------------------------- */
#define USER_TRACE_BEAT   1
#define USER_TRACE_WORK   2

#define BEAT_PERIOD_MS    50

static K_MUTEX_DEFINE(shared_lock);

/* ---------------- Worker: periodic mutex holder ------------------------- */
static void worker_thread(void *a, void *b, void *c)
{
    ARG_UNUSED(a); ARG_UNUSED(b); ARG_UNUSED(c);
    int32_t work = 0;

    while (1) {
        k_mutex_lock(&shared_lock, K_FOREVER);
        work += 1;
        VA_LogTrace(USER_TRACE_WORK, work);
        k_busy_wait(300);                 /* 0.3 ms of "work" under the lock */
        k_mutex_unlock(&shared_lock);

        k_msleep(120);
    }
}
K_THREAD_DEFINE(worker_tid, 768, worker_thread, NULL, NULL, NULL,
                K_PRIO_PREEMPT(5), 0, 0);

int main(void)
{
    if (!device_is_ready(led.port)) {
        return -1;
    }
    gpio_pin_configure_dt(&led, GPIO_OUTPUT_ACTIVE);

    k_msleep(1000);                       /* give the host time to attach */

    /* The tick source must be RUNNING before VA_Init: it probes the timer
     * and reports ERR:TS_DEAD to the host (and refuses to start) if the
     * counter is not moving. To see that failure path in the app or CLI,
     * comment out this call. */
    tick_timer_init();

    VA_Init((uint32_t)CONFIG_SYS_CLOCK_HW_CYCLES_PER_SEC,
            tick_timer_read, TICK_HZ);
    VA_Zephyr_RegisterExistingThreads();

    VA_RegisterUserTrace(USER_TRACE_BEAT, "Beat", VA_USER_TYPE_COUNTER);
    VA_RegisterUserTrace(USER_TRACE_WORK, "Work", VA_USER_TYPE_COUNTER);

    int32_t beat = 0;
    while (1) {
        gpio_pin_toggle_dt(&led);

        k_mutex_lock(&shared_lock, K_FOREVER);
        VA_LogTrace(USER_TRACE_BEAT, ++beat);
        k_mutex_unlock(&shared_lock);

        /* 16-bit source: this is the wrap-budget backstop (see above). */
        VA_TickOverflowCheck();
        k_msleep(BEAT_PERIOD_MS);
    }

    return 0;
}
```
